/dts-v1/;

/ {

	fragment@0 {
		target = <0xffffffff>;

		__overlay__ {
			battery_cv = <0x4371a0>;
			ac_charger_current = <0x1c3a90>;
		};
	};

	fragment@1 {
		target = <0xffffffff>;

		__overlay__ {
			DIFFERENCE_FULLOCV_ITH = <0xc8>;
			SHUTDOWN_1_TIME = <0x14>;
			KEEP_100_PERCENT = <0x01>;
			R_FG_VALUE = <0x0a>;
			EMBEDDED_SEL = <0x01>;
			PMIC_SHUTDOWN_CURRENT = <0x14>;
			FG_METER_RESISTANCE = <0x4b>;
			CAR_TUNE_VALUE = <0x5e>;
			PMIC_MIN_VOL = <0x7d00>;
			POWERON_SYSTEM_IBOOT = <0x1f4>;
			SHUTDOWN_GAUGE0_VOLTAGE = <0x7d00>;
			TEMPERATURE_T0 = <0x32>;
			TEMPERATURE_T1 = <0x19>;
			TEMPERATURE_T2 = <0x0a>;
			TEMPERATURE_T3 = <0x00>;
			TEMPERATURE_T4 = <0xfffffff6>;
			g_FG_PSEUDO100_T0 = <0x64>;
			g_FG_PSEUDO100_T1 = <0x64>;
			g_FG_PSEUDO100_T2 = <0x64>;
			g_FG_PSEUDO100_T3 = <0x64>;
			g_FG_PSEUDO100_T4 = <0x64>;
			Q_MAX_SYS_VOLTAGE_BAT0 = <0xd16>;
			Q_MAX_SYS_VOLTAGE_BAT1 = <0xd16>;
			Q_MAX_SYS_VOLTAGE_BAT2 = <0xd16>;
			Q_MAX_SYS_VOLTAGE_BAT3 = <0xd16>;
			battery0_profile_t0_num = <0x64>;
			battery0_profile_t0 = <0x00 0xab6c 0x44c 0x14d 0xaac5 0x44b 0x29a 0xaa22 0x43f 0x3e7 0xa988 0x45a 0x534 0xa8e9 0x44e 0x681 0xa84d 0x446 0x7ce 0xa7be 0x443 0x91b 0xa732 0x441 0xa67 0xa6af 0x44a 0xbb4 0xa626 0x43f 0xd01 0xa59d 0x43d 0xe4e 0xa526 0x44e 0xf9b 0xa4ab 0x446 0x10e8 0xa435 0x452 0x1235 0xa3b9 0x459 0x1382 0xa33d 0x45d 0x14cf 0xa2c7 0x45f 0x161c 0xa24e 0x465 0x1769 0xa1db 0x469 0x18b6 0xa16f 0x477 0x1a03 0xa0fc 0x47d 0x1b50 0xa083 0x476 0x1c9c 0xa012 0x476 0x1de9 0x9fab 0x480 0x1f36 0x9f3c 0x486 0x2083 0x9ed1 0x499 0x21d0 0x9e66 0x494 0x231d 0x9dfe 0x493 0x246a 0x9d9b 0x49d 0x25b7 0x9d3d 0x4ad 0x2704 0x9cde 0x4be 0x2851 0x9c7f 0x4bd 0x299e 0x9c1f 0x4c6 0x2aeb 0x9bbf 0x4bc 0x2c38 0x9b69 0x4bf 0x2d85 0x9b12 0x4cd 0x2ed1 0x9abc 0x4d6 0x301e 0x9a6d 0x4ed 0x316b 0x9a1b 0x4fa 0x32b8 0x99c5 0x4f6 0x3405 0x9970 0x4fb 0x3552 0x9914 0x4f8 0x369f 0x98b8 0x4e2 0x37ec 0x985f 0x4d9 0x3939 0x97f9 0x4b9 0x3a86 0x9799 0x49c 0x3bd3 0x973f 0x497 0x3d20 0x96e2 0x47a 0x3e6d 0x968d 0x468 0x3fba 0x964e 0x464 0x4106 0x960d 0x458 0x4253 0x95d4 0x451 0x43a0 0x9598 0x440 0x44ed 0x9568 0x448 0x463a 0x953a 0x452 0x4787 0x9518 0x468 0x48d4 0x94e7 0x46b 0x4a21 0x94b8 0x466 0x4b6e 0x948f 0x467 0x4cbb 0x946f 0x46d 0x4e08 0x944f 0x480 0x4f55 0x9429 0x482 0x50a2 0x9407 0x482 0x51ef 0x93e9 0x486 0x533b 0x93d0 0x498 0x5488 0x93b9 0x49d 0x55d5 0x939b 0x49e 0x5722 0x937d 0x48e 0x586f 0x9360 0x48f 0x59bc 0x9342 0x48f 0x5b09 0x9315 0x47d 0x5c56 0x92c5 0x44a 0x5da3 0x9285 0x43d 0x5ef0 0x9261 0x44e 0x603d 0x9244 0x45d 0x618a 0x921c 0x45a 0x62d7 0x91f5 0x44d 0x6424 0x91c9 0x44a 0x6570 0x91aa 0x463 0x66bd 0x916c 0x461 0x680a 0x9116 0x465 0x6957 0x90d1 0x474 0x6aa4 0x9083 0x465 0x6bf1 0x903e 0x45c 0x6d3e 0x8fd4 0x45b 0x6e8b 0x8f4d 0x466 0x6fd8 0x8f00 0x44f 0x7125 0x8eab 0x443 0x7272 0x8e3f 0x45a 0x73bf 0x8dd3 0x47d 0x750c 0x8d61 0x49c 0x7659 0x8ca4 0x4bf 0x77a5 0x8bed 0x4cd 0x78f2 0x8b23 0x4b6 0x7a3f 0x89a6 0x4ad 0x7b8c 0x87ea 0x4dd 0x7cd9 0x8708 0x53b 0x7e26 0x85ee 0x5e5 0x7f73 0x852e 0x5f5 0x80c0 0x82d6 0x5f5>;
			battery0_profile_t1_num = <0x64>;
			battery0_profile_t1 = <0x00 0xab31 0x5b7 0x14d 0xaa6d 0x5b7 0x29a 0xa9cf 0x5ba 0x3e7 0xa93d 0x5b2 0x534 0xa8b3 0x5b7 0x681 0xa82b 0x5b7 0x7ce 0xa7a7 0x5b5 0x91b 0xa726 0x5b9 0xa67 0xa6a8 0x5ba 0xbb4 0xa62c 0x5bd 0xd01 0xa5b3 0x5c6 0xe4e 0xa538 0x5d4 0xf9b 0xa4be 0x5dc 0x10e8 0xa446 0x5e3 0x1235 0xa3cf 0x5ea 0x1382 0xa359 0x5eb 0x14cf 0xa2e6 0x5fa 0x161c 0xa273 0x603 0x1769 0xa1ff 0x604 0x18b6 0xa18d 0x60d 0x1a03 0xa11b 0x632 0x1b50 0xa0a8 0x650 0x1c9c 0xa036 0x657 0x1de9 0x9fc8 0x66f 0x1f36 0x9f5d 0x67d 0x2083 0x9ef8 0x681 0x21d0 0x9eba 0x6af 0x231d 0x9e71 0x6b3 0x246a 0x9ded 0x689 0x25b7 0x9d4d 0x671 0x2704 0x9cb5 0x66c 0x2851 0x9c30 0x66e 0x299e 0x9bc5 0x677 0x2aeb 0x9b74 0x688 0x2c38 0x9b3f 0x6ab 0x2d85 0x9b10 0x6c7 0x2ed1 0x9acc 0x6c1 0x301e 0x9a7d 0x6be 0x316b 0x9a2e 0x6c1 0x32b8 0x99e2 0x6c8 0x3405 0x9998 0x6ce 0x3552 0x9947 0x6cc 0x369f 0x98ef 0x6ba 0x37ec 0x988e 0x6a5 0x3939 0x9823 0x67a 0x3a86 0x97b2 0x649 0x3bd3 0x9746 0x61e 0x3d20 0x96e6 0x5ef 0x3e6d 0x9697 0x5d6 0x3fba 0x9651 0x5c8 0x4106 0x9613 0x5c0 0x4253 0x95db 0x5b7 0x43a0 0x95a7 0x5b9 0x44ed 0x9575 0x5b9 0x463a 0x9547 0x5bb 0x4787 0x951b 0x5ba 0x48d4 0x94f1 0x5b9 0x4a21 0x94c9 0x5be 0x4b6e 0x94a5 0x5c4 0x4cbb 0x9480 0x5c6 0x4e08 0x945c 0x5c8 0x4f55 0x943c 0x5c9 0x50a2 0x941c 0x5c8 0x51ef 0x93fe 0x5cb 0x533b 0x93e3 0x5d0 0x5488 0x93c9 0x5d3 0x55d5 0x93b0 0x5d6 0x5722 0x9399 0x5dc 0x586f 0x9384 0x5e2 0x59bc 0x936e 0x5e4 0x5b09 0x9359 0x5e1 0x5c56 0x9344 0x5e1 0x5da3 0x9332 0x5e1 0x5ef0 0x931c 0x5e8 0x603d 0x9305 0x5e5 0x618a 0x92ea 0x5e7 0x62d7 0x92c8 0x5dd 0x6424 0x92a3 0x5d5 0x6570 0x9279 0x5d7 0x66bd 0x9253 0x5d3 0x680a 0x9230 0x5d8 0x6957 0x920c 0x5e2 0x6aa4 0x91db 0x5e5 0x6bf1 0x919a 0x5e4 0x6d3e 0x9143 0x5e2 0x6e8b 0x90d2 0x5e8 0x6fd8 0x905b 0x5ed 0x7125 0x8fd3 0x5e4 0x7272 0x8f42 0x5e3 0x73bf 0x8ec0 0x5ef 0x750c 0x8e0e 0x602 0x7659 0x8d77 0x61b 0x77a5 0x8cbc 0x63b 0x78f2 0x8bd9 0x669 0x7a3f 0x8ae2 0x6a2 0x7b8c 0x8a11 0x69b 0x7cd9 0x892e 0x6a4 0x7e26 0x88f8 0x6ec 0x7f73 0x8846 0x77b 0x80c0 0x827b 0x90c>;
			battery0_profile_t2_num = <0x64>;
			battery0_profile_t2 = <0x00 0xab31 0x5b7 0x14d 0xaa6d 0x5b7 0x29a 0xa9cf 0x5ba 0x3e7 0xa93d 0x5b2 0x534 0xa8b3 0x5b7 0x681 0xa82b 0x5b7 0x7ce 0xa7a7 0x5b5 0x91b 0xa726 0x5b9 0xa67 0xa6a8 0x5ba 0xbb4 0xa62c 0x5bd 0xd01 0xa5b3 0x5c6 0xe4e 0xa538 0x5d4 0xf9b 0xa4be 0x5dc 0x10e8 0xa446 0x5e3 0x1235 0xa3cf 0x5ea 0x1382 0xa359 0x5eb 0x14cf 0xa2e6 0x5fa 0x161c 0xa273 0x603 0x1769 0xa1ff 0x604 0x18b6 0xa18d 0x60d 0x1a03 0xa11b 0x632 0x1b50 0xa0a8 0x650 0x1c9c 0xa036 0x657 0x1de9 0x9fc8 0x66f 0x1f36 0x9f5d 0x67d 0x2083 0x9ef8 0x681 0x21d0 0x9eba 0x6af 0x231d 0x9e71 0x6b3 0x246a 0x9ded 0x689 0x25b7 0x9d4d 0x671 0x2704 0x9cb5 0x66c 0x2851 0x9c30 0x66e 0x299e 0x9bc5 0x677 0x2aeb 0x9b74 0x688 0x2c38 0x9b3f 0x6ab 0x2d85 0x9b10 0x6c7 0x2ed1 0x9acc 0x6c1 0x301e 0x9a7d 0x6be 0x316b 0x9a2e 0x6c1 0x32b8 0x99e2 0x6c8 0x3405 0x9998 0x6ce 0x3552 0x9947 0x6cc 0x369f 0x98ef 0x6ba 0x37ec 0x988e 0x6a5 0x3939 0x9823 0x67a 0x3a86 0x97b2 0x649 0x3bd3 0x9746 0x61e 0x3d20 0x96e6 0x5ef 0x3e6d 0x9697 0x5d6 0x3fba 0x9651 0x5c8 0x4106 0x9613 0x5c0 0x4253 0x95db 0x5b7 0x43a0 0x95a7 0x5b9 0x44ed 0x9575 0x5b9 0x463a 0x9547 0x5bb 0x4787 0x951b 0x5ba 0x48d4 0x94f1 0x5b9 0x4a21 0x94c9 0x5be 0x4b6e 0x94a5 0x5c4 0x4cbb 0x9480 0x5c6 0x4e08 0x945c 0x5c8 0x4f55 0x943c 0x5c9 0x50a2 0x941c 0x5c8 0x51ef 0x93fe 0x5cb 0x533b 0x93e3 0x5d0 0x5488 0x93c9 0x5d3 0x55d5 0x93b0 0x5d6 0x5722 0x9399 0x5dc 0x586f 0x9384 0x5e2 0x59bc 0x936e 0x5e4 0x5b09 0x9359 0x5e1 0x5c56 0x9344 0x5e1 0x5da3 0x9332 0x5e1 0x5ef0 0x931c 0x5e8 0x603d 0x9305 0x5e5 0x618a 0x92ea 0x5e7 0x62d7 0x92c8 0x5dd 0x6424 0x92a3 0x5d5 0x6570 0x9279 0x5d7 0x66bd 0x9253 0x5d3 0x680a 0x9230 0x5d8 0x6957 0x920c 0x5e2 0x6aa4 0x91db 0x5e5 0x6bf1 0x919a 0x5e4 0x6d3e 0x9143 0x5e2 0x6e8b 0x90d2 0x5e8 0x6fd8 0x905b 0x5ed 0x7125 0x8fd3 0x5e4 0x7272 0x8f42 0x5e3 0x73bf 0x8ec0 0x5ef 0x750c 0x8e0e 0x602 0x7659 0x8d77 0x61b 0x77a5 0x8cbc 0x63b 0x78f2 0x8bd9 0x669 0x7a3f 0x8ae2 0x6a2 0x7b8c 0x8a11 0x69b 0x7cd9 0x892e 0x6a4 0x7e26 0x88f8 0x6ec 0x7f73 0x8846 0x77b 0x80c0 0x827b 0x90c>;
			battery0_profile_t3_num = <0x64>;
			battery0_profile_t3 = <0x00 0xaaa2 0xc21 0x14d 0xa973 0xc2b 0x29a 0xa842 0xd2e 0x3e7 0xa76c 0xe39 0x534 0xa6c8 0xec1 0x681 0xa639 0xef4 0x7ce 0xa5b1 0xeef 0x91b 0xa52f 0xef8 0xa67 0xa4b2 0xf00 0xbb4 0xa43a 0xf0f 0xd01 0xa3c3 0xf3f 0xe4e 0xa34e 0xf25 0xf9b 0xa2da 0xf1f 0x10e8 0xa264 0xf8b 0x1235 0xa1ef 0xf90 0x1382 0xa17b 0xeb0 0x14cf 0xa108 0xe8c 0x161c 0xa098 0xebc 0x1769 0xa032 0xedb 0x18b6 0x9fcc 0xef4 0x1a03 0x9f70 0xefb 0x1b50 0x9f36 0xec0 0x1c9c 0x9ed9 0xf53 0x1de9 0x9e3a 0xf09 0x1f36 0x9d76 0xf0d 0x2083 0x9cbd 0xeea 0x21d0 0x9c1f 0xf15 0x231d 0x9b9f 0xe73 0x246a 0x9b3d 0xec9 0x25b7 0x9ae5 0xe92 0x2704 0x9a97 0xf4a 0x2851 0x9a58 0xfa5 0x299e 0x9a1b 0xf93 0x2aeb 0x99d6 0xf64 0x2c38 0x9987 0xf22 0x2d85 0x9932 0xec2 0x2ed1 0x98d9 0xe9d 0x301e 0x987f 0xe77 0x316b 0x9824 0xe3a 0x32b8 0x97cb 0xe18 0x3405 0x9774 0xe5b 0x3552 0x9724 0xe30 0x369f 0x96db 0xe24 0x37ec 0x9698 0xda0 0x3939 0x9659 0xdee 0x3a86 0x961f 0xdfa 0x3bd3 0x95e9 0xdef 0x3d20 0x95b6 0xe08 0x3e6d 0x9589 0xe58 0x3fba 0x955b 0xe6d 0x4106 0x9530 0xe78 0x4253 0x9506 0xe9e 0x43a0 0x94e0 0xe5f 0x44ed 0x94b9 0xec6 0x463a 0x9496 0xe75 0x4787 0x9474 0xe77 0x48d4 0x9453 0xe78 0x4a21 0x9434 0xed7 0x4b6e 0x9417 0xef7 0x4cbb 0x93fb 0xf07 0x4e08 0x93e2 0xf00 0x4f55 0x93cc 0xf1c 0x50a2 0x93ba 0xf33 0x51ef 0x93a9 0xf0e 0x533b 0x9398 0xf34 0x5488 0x938a 0xf87 0x55d5 0x9379 0xfc1 0x5722 0x9367 0xfdd 0x586f 0x9353 0xfb8 0x59bc 0x933a 0xf6f 0x5b09 0x9322 0xeea 0x5c56 0x9305 0xf5e 0x5da3 0x92e6 0xf5b 0x5ef0 0x92bf 0xf9b 0x603d 0x9291 0xf98 0x618a 0x9263 0xfa7 0x62d7 0x9229 0x1025 0x6424 0x91f2 0xfe8 0x6570 0x91b5 0x1013 0x66bd 0x916e 0x1059 0x680a 0x9122 0x1034 0x6957 0x90e1 0x109c 0x6aa4 0x90b9 0x10f5 0x6bf1 0x909c 0x1185 0x6d3e 0x9084 0x11f6 0x6e8b 0x906d 0x12c6 0x6fd8 0x904a 0x1407 0x7125 0x9012 0x1548 0x7272 0x8f95 0x16d4 0x73bf 0x8e6d 0x1866 0x750c 0x8c78 0x1b4c 0x7659 0x89bd 0x1f2a 0x77a5 0x8600 0x1a4f 0x78f2 0x8416 0x1752 0x7a3f 0x8416 0x1752 0x7b8c 0x8416 0x1752 0x7cd9 0x8416 0x1752 0x7e26 0x8416 0x1752 0x7f73 0x8416 0x1752 0x80c0 0x8286 0x1752>;
			battery0_profile_t4_num = <0x64>;
			battery0_profile_t4 = <0x00 0xaa52 0x11d6 0x14d 0xa99a 0x11db 0x29a 0xa900 0x1257 0x3e7 0xa86f 0x1293 0x534 0xa7d8 0x12e4 0x681 0xa728 0x1374 0x7ce 0xa633 0x149b 0x91b 0xa4fa 0x16e0 0xa67 0xa3f4 0x19ca 0xbb4 0xa352 0x1b04 0xd01 0xa2cb 0x1b46 0xe4e 0xa24b 0x1b65 0xf9b 0xa1d1 0x1b7c 0x10e8 0xa15c 0x1b8e 0x1235 0xa0e8 0x1b98 0x1382 0xa079 0x1b9b 0x14cf 0xa00f 0x1b9f 0x161c 0x9fac 0x1bad 0x1769 0x9f5a 0x1bd4 0x18b6 0x9f00 0x1bf0 0x1a03 0x9e7f 0x1be5 0x1b50 0x9dca 0x1bb0 0x1c9c 0x9cff 0x1b7f 0x1de9 0x9c45 0x1b63 0x1f36 0x9ba9 0x1b4c 0x2083 0x9b28 0x1b42 0x21d0 0x9abc 0x1b36 0x231d 0x9a5f 0x1b28 0x246a 0x9a0b 0x1b29 0x25b7 0x99bf 0x1b25 0x2704 0x9975 0x1b19 0x2851 0x9929 0x1b0d 0x299e 0x98dc 0x1afa 0x2aeb 0x988e 0x1ae3 0x2c38 0x983e 0x1ad0 0x2d85 0x97ef 0x1abe 0x2ed1 0x97a1 0x1ab2 0x301e 0x9757 0x1aa7 0x316b 0x970f 0x1aa0 0x32b8 0x96cb 0x1aa7 0x3405 0x968b 0x1aaf 0x3552 0x964d 0x1ab3 0x369f 0x9613 0x1ac0 0x37ec 0x95db 0x1acb 0x3939 0x95a6 0x1ada 0x3a86 0x9577 0x1af2 0x3bd3 0x9547 0x1aff 0x3d20 0x951a 0x1b1e 0x3e6d 0x94ed 0x1b31 0x3fba 0x94c3 0x1b40 0x4106 0x949a 0x1b53 0x4253 0x9472 0x1b5e 0x43a0 0x944d 0x1b78 0x44ed 0x9429 0x1b90 0x463a 0x9408 0x1b9d 0x4787 0x93ea 0x1bb6 0x48d4 0x93cf 0x1bc2 0x4a21 0x93b5 0x1bd8 0x4b6e 0x939d 0x1bf0 0x4cbb 0x9384 0x1c06 0x4e08 0x936c 0x1c21 0x4f55 0x9353 0x1c3e 0x50a2 0x933a 0x1c5f 0x51ef 0x931e 0x1c85 0x533b 0x9301 0x1caf 0x5488 0x92e2 0x1ce3 0x55d5 0x92c1 0x1d14 0x5722 0x929e 0x1d4b 0x586f 0x927a 0x1d8c 0x59bc 0x9251 0x1dd6 0x5b09 0x9223 0x1e25 0x5c56 0x91f3 0x1e81 0x5da3 0x91bf 0x1edb 0x5ef0 0x918d 0x1f49 0x603d 0x915b 0x1fb5 0x618a 0x912c 0x204b 0x62d7 0x9101 0x20f1 0x6424 0x90d7 0x21af 0x6570 0x90ac 0x2299 0x66bd 0x907e 0x23a6 0x680a 0x9046 0x24e1 0x6957 0x8ffe 0x264d 0x6aa4 0x8f91 0x27e0 0x6bf1 0x8ef9 0x2858 0x6d3e 0x8e1f 0x2703 0x6e8b 0x8ccd 0x24f3 0x6fd8 0x8ad4 0x21de 0x7125 0x880b 0x1d84 0x7272 0x85fe 0x1a48 0x73bf 0x84d3 0x1877 0x750c 0x84d3 0x1877 0x7659 0x84d3 0x1877 0x77a5 0x84d3 0x1877 0x78f2 0x84d3 0x1877 0x7a3f 0x84d3 0x1877 0x7b8c 0x84d3 0x1877 0x7cd9 0x84d3 0x1877 0x7e26 0x84d3 0x1877 0x7f73 0x84d3 0x1877 0x80c0 0x84d3 0x1877>;
		};
	};

	fragment@2 {
		target = <0xffffffff>;

		__overlay__ {

			extcon_iddig {
				compatible = "mediatek,extcon-usb";
				id-gpio = <0xffffffff 0x27 0x00>;
				pinctrl-names = "default";
				pinctrl-0 = <0x01>;
				vbus-supply = <0x02>;
				vbus-voltage = <0x4c4b40>;
				vbus-current = <0x1b7740>;
				charger = <0xffffffff>;
				phandle = <0x43>;

				port {

					endpoint@0 {
						remote-endpoint = <0x03>;
						phandle = <0x3a>;
					};
				};
			};

			mt_soc_codec_name {
				compatible = "mediatek,mt_soc_codec_63xx";
				use_hp_depop_flow = <0x00>;
				use_ul_260k = <0x00>;
				phandle = <0x44>;
			};

			fixedregulator0 {
				compatible = "regulator-fixed";
				regulator-name = "mmc_power";
				regulator-min-microvolt = <0x325aa0>;
				regulator-max-microvolt = <0x325aa0>;
				enable-active-high;
				regulator-always-on;
				phandle = <0x32>;
			};

			fixedregulator1 {
				compatible = "regulator-fixed";
				regulator-name = "mmc_io";
				regulator-min-microvolt = <0x1b7740>;
				regulator-max-microvolt = <0x1b7740>;
				enable-active-high;
				regulator-always-on;
				phandle = <0x33>;
			};

			sound {
				compatible = "mediatek,mt8168-p1";
				mediatek,platform = <0xffffffff>;
				mediatek,adsp-platform = <0xffffffff>;
				pinctrl-names = "aud_mosi_on", "aud_mosi_off", "aud_miso_on", "aud_miso_off", "default", "aud_dmic", "aud_pcm", "aud_i2s0", "aud_i2s1", "aud_i2s2", "aud_i2s3", "aud_tdm_out", "aud_tdm_in";
				pinctrl-0 = <0x04>;
				pinctrl-1 = <0x05>;
				pinctrl-2 = <0x06>;
				pinctrl-3 = <0x07>;
				pinctrl-4 = <0x08>;
				pinctrl-5 = <0x09>;
				pinctrl-6 = <0x0a>;
				pinctrl-7 = <0x0b>;
				pinctrl-8 = <0x0c>;
				pinctrl-9 = <0x0d>;
				pinctrl-10 = <0x0e>;
				pinctrl-11 = <0x0f>;
				pinctrl-12 = <0x10>;
				ext-amp1-gpio = <0xffffffff 0x44 0x00>;
				ext-amp2-gpio = <0xffffffff 0x45 0x00>;
				mediatek,headset-codec = <0xffffffff>;
				status = "okay";
				phandle = <0x45>;
			};

			pwmleds {
				compatible = "mediatek,pwm-leds";
				phandle = <0x46>;

				backlight {
					label = "lcd-backlight";
					pwms = <0xffffffff 0x00 0x99d9>;
					max-brightness = <0xff>;
					max-hw-brightness = <0x3ff>;
					default-state = "half";
					pwm-names = "lcd-backlight";
				};
			};

			regulator@0 {
				compatible = "regulator-fixed";
				regulator-name = "vbus";
				regulator-min-microvolt = <0x4c4b40>;
				regulator-max-microvolt = <0x4c4b40>;
				gpio = <0xffffffff 0x28 0x00>;
				enable-active-high;
				phandle = <0x39>;
			};

			type_c_port0 {
				tcpc-dual,supported_modes = <0x00>;
				mt-tcpc,name = "type_c_port0";
				mt-tcpc,role_def = <0x04>;
				mt-tcpc,rp_level = <0x01>;
				mt-tcpc,vconn_supply = <0x01>;
				mt-tcpc,notifier_supply_num = <0x02>;
				mt6370pd,intr_gpio = <0xffffffff 0x54 0x00>;
				phandle = <0x47>;
			};
		};
	};

	fragment@3 {
		target = <0xffffffff>;

		__overlay__ {
			status = "okay";
		};
	};

	fragment@4 {
		target = <0xffffffff>;

		__overlay__ {
			mediatek,dl1-use-sram = <0x11221000 0x5000>;
			status = "okay";
		};
	};

	fragment@5 {
		target = <0xffffffff>;

		__overlay__ {
			status = "okay";
		};
	};

	fragment@6 {
		target = <0xffffffff>;

		__overlay__ {
			status = "okay";
		};
	};

	fragment@7 {
		target = <0xffffffff>;

		__overlay__ {
			algorithm_name = "Basic";
			enable_dynamic_mivr;
			min_charger_voltage = <0x432380>;
			bootmode = <0xffffffff>;
			charger_configuration = <0x00>;
			charger = <0xffffffff>;
			gauge = <0xffffffff>;
		};
	};

	fragment@8 {
		target = <0xffffffff>;

		__overlay__ {
			pinctrl-names = "default", "gps_lna_state_init", "gps_lna_state_oh", "gps_lna_state_ol";
			pinctrl-0 = <0x11>;
			pinctrl-1 = <0x12>;
			pinctrl-2 = <0x13>;
			pinctrl-3 = <0x14>;
			status = "okay";
		};
	};

	fragment@9 {
		target = <0xffffffff>;

		__overlay__ {
			clock-frequency = <0x989680>;
		};
	};

	fragment@10 {
		target = <0xffffffff>;

		__overlay__ {
			clock-frequency = <0x989680>;
		};
	};

	fragment@11 {
		target = <0xffffffff>;

		__overlay__ {
			clock-frequency = <0x989680>;
		};
	};

	fragment@12 {
		target = <0xffffffff>;

		__overlay__ {
			clock-frequency = <0x989680>;
		};
	};

	fragment@13 {
		target = <0xffffffff>;

		__overlay__ {
			status = "okay";
			#address-cells = <0x01>;
			#size-cells = <0x00>;

			panel0@0 {
				compatible = "MJT070032M";
				reg = <0x00>;
				pwr-gpios = <0xffffffff 0x15 0x00>;
				rst-gpios = <0xffffffff 0x14 0x00>;
				lcmavdd-supply = <0xffffffff>;
				pinctrl-names = "default";
				pinctrl-0 = <0x15>;
				status = "okay";
				rotation = <0x10e>;

				port {

					endpoint {
						remote-endpoint = <0x16>;
						phandle = <0x17>;
					};
				};
			};

			panel1@1 {
				compatible = "SAT070HK30I21Y03";
				reg = <0x01>;
				pwr-gpios = <0xffffffff 0x15 0x00>;
				rst-gpios = <0xffffffff 0x14 0x00>;
				lcmavdd-supply = <0xffffffff>;
				pinctrl-names = "default";
				pinctrl-0 = <0x15>;
				status = "okay";
				rotation = <0x10e>;

				port {

					endpoint {
						remote-endpoint = <0x16>;
						phandle = <0x48>;
					};
				};
			};

			panel2@2 {
				compatible = "zs,ne3008b3";
				reg = <0x03>;
				pwr-gpios = <0xffffffff 0x15 0x00>;
				rst-gpios = <0xffffffff 0x14 0x00>;
				lcmavdd-supply = <0xffffffff>;
				pinctrl-names = "default";
				pinctrl-0 = <0x15>;
				status = "okay";
				rotation = <0x10e>;

				port {

					endpoint {
						remote-endpoint = <0x16>;
						phandle = <0x49>;
					};
				};
			};

			ports {

				port {

					endpoint {
						remote-endpoint = <0x17>;
						phandle = <0x16>;
					};
				};
			};
		};
	};

	fragment@14 {
		target = <0xffffffff>;

		__overlay__ {
			pinctrl-names = "default";
			pinctrl-0 = <0x18>;
			status = "okay";
		};
	};

	fragment@15 {
		target = <0xffffffff>;

		__overlay__ {
			status = "disabled";
			pinctrl-names = "default";
			pinctrl-0 = <0x19>;
		};
	};

	fragment@16 {
		target = <0xffffffff>;

		__overlay__ {
			pinctrl-names = "default";
			pinctrl-0 = <0x1a>;
			clock-frequency = <0x61a80>;
			status = "okay";

			wusb3801@60 {
				compatible = "mediatek,usb_type_c";
				reg = <0x60>;
				mt-tcpc,name = "type_c_port0";
				wusb3801,init-mode = <0x20>;
				wusb3801,host-current = <0x01>;
				wusb3801,drp-toggle-time = <0x00>;
				pinctrl-names = "wusb_intr";
				pinctrl-0 = <0x1b>;
				status = "okay";
				phandle = <0x4a>;
			};

			fsa4480-12c@42 {
				compatible = "mediatek,fsa4480-i2c";
				reg = <0x42>;
				status = "okay";
				phandle = <0x4b>;
			};

			eta6937@6a {
				compatible = "hcn,eta6937";
				reg = <0x6a>;
				interrupt-parent = <0xffffffff>;
				interrupts = <0x11 0x04>;
				hl7005,cd_pin = <0xffffffff 0x11 0x00>;
				charger_name = "primary_chg";
				status = "okay";
				phandle = <0x36>;

				usb-otg-vbus {
					regulator-compatible = "hl7005,otg-vbus";
					regulator-name = "usb-otg-vbus";
					regulator-min-microvolt = <0x438528>;
					regulator-max-microvolt = <0x58e1e8>;
					regulator-min-microamp = <0x7a120>;
					regulator-max-microamp = <0x249f00>;
					phandle = <0x02>;
				};
			};
		};
	};

	fragment@17 {
		target = <0xffffffff>;

		__overlay__ {
			pinctrl-names = "default";
			pinctrl-0 = <0x1c>;
			clock-frequency = <0x186a0>;
			status = "okay";

			cap_touch@5d {
				compatible = "mediatek,cap_touch";
				reg = <0x5d>;
				interrupt-parent = <0xffffffff>;
				interrupts = <0x05 0x02>;
				int-gpio = <0xffffffff 0x05 0x00>;
				rst-gpio = <0xffffffff 0x04 0x00>;
			};
		};
	};

	fragment@18 {
		target = <0xffffffff>;

		__overlay__ {
			pinctrl-names = "default";
			pinctrl-0 = <0x1d>;
			clock-frequency = <0x186a0>;
			status = "okay";

			alsps@23 {
				compatible = "mediatek,alsps";
				reg = <0x23>;
				interrupt-parent = <0xffffffff>;
				interrupts = <0x0a 0x08>;
				debounce = <0x0a 0x00>;
				pinctrl-names = "pin_default", "pin_cfg";
				pinctrl-0 = <0x1e>;
				pinctrl-1 = <0x1f>;
				status = "okay";
				i2c_num = <0x02>;
				i2c_addr = <0x23 0x00 0x00 0x00>;
				polling_mode_ps = <0x00>;
				polling_mode_als = <0x01>;
				power_id = <0xffff>;
				power_vol = <0x00>;
				als_level = <0x00 0x01 0x01 0x07 0x0f 0x0f 0x64 0x3e8 0x7d0 0xbb8 0x1770 0x2710 0x36b0 0x4650 0x4e20>;
				als_value = <0x28 0x28 0x5a 0x5a 0xa0 0xa0 0xe1 0x140 0x280 0x500 0x500 0xa28 0xa28 0xa28 0x2800 0x2800>;
				ps_threshold_high = <0x384>;
				ps_threshold_low = <0x258>;
				is_batch_supported_ps = <0x00>;
				is_batch_supported_als = <0x00>;
			};

			gsensor@15 {
				compatible = "mediatek,gsensor_mxc400x";
				reg = <0x15>;
				status = "okay";
				i2c_num = <0x02>;
				i2c_addr = <0x18 0x00 0x00 0x00>;
				direction = <0x06>;
				power_id = <0xffff>;
				power_vol = <0x00>;
				firlen = <0x00>;
				is_batch_supported = <0x00>;
			};

			gsensor@26 {
				compatible = "mediatek,gsensor_mir3da";
				reg = <0x26>;
				status = "okay";
				i2c_num = <0x02>;
				i2c_addr = <0x18 0x00 0x00 0x00>;
				direction = <0x05>;
				power_id = <0xffff>;
				power_vol = <0x00>;
				firlen = <0x00>;
				is_batch_supported = <0x00>;
			};
		};
	};

	fragment@19 {
		target = <0xffffffff>;

		__overlay__ {
			pinctrl-names = "default";
			pinctrl-0 = <0x20>;
			clock-frequency = <0x186a0>;
			status = "okay";

			kd_camera_hw1@20 {
				compatible = "mediatek,camera_main";
				reg = <0x3c>;
			};
		};
	};

	fragment@20 {
		target = <0xffffffff>;

		__overlay__ {
			pinctrl-names = "default";
			pinctrl-0 = <0x21>;
			status = "okay";
		};
	};

	fragment@21 {
		target = <0xffffffff>;

		__overlay__ {
			pinctrl-names = "default";
			pinctrl-0 = <0x22>;
			status = "okay";
			mediatek,key-debounce-ms = <0x400>;
			mediatek,kpd-sw-pwrkey = <0x74>;
			mediatek,kpd-hw-pwrkey = <0x01>;
			mediatek,use-extend-type = <0x00>;
			mediatek,hw-map-num = <0x48>;
			mediatek,hw-init-map = <0x73 0x00 0x00 0x00 0x00 0x00 0x00 0x00 0x00 0x00 0x00 0x00 0x00 0x00 0x00 0x00 0x00 0x00 0x00 0x00 0x00 0x00 0x00 0x00 0x00 0x00 0x00 0x00 0x00 0x00 0x00 0x00 0x00 0x00 0x00 0x00 0x00 0x00 0x00 0x00 0x00 0x00 0x00 0x00 0x00 0x00 0x00 0x00 0x00 0x00 0x00 0x00 0x00 0x00 0x00 0x00 0x00 0x00 0x00 0x00 0x00 0x00 0x00 0x00 0x00 0x00 0x00 0x00 0x00 0x00 0x00 0x00>;
			mediatek,kpd-pwrkey-eint-gpio = <0x00>;
			mediatek,kpd-pwkey-gpio-din = <0x00>;
			mediatek,kpd-hw-dl-key0 = <0x00>;
			mediatek,kpd-hw-dl-key1 = <0x03>;
			mediatek,kpd-hw-dl-key2 = <0x01>;
			mediatek,kpd-hw-recovery-key = <0x00>;
			mediatek,kpd-hw-factory-key = <0x03>;
		};
	};

	fragment@22 {
		target = <0xffffffff>;

		__overlay__ {
			vcama-supply = <0xffffffff>;
			vcamd-supply = <0xffffffff>;
			vcamio-supply = <0xffffffff>;
			vcama_sub-supply = <0xffffffff>;
			vcamd_sub-supply = <0xffffffff>;
			vcamio_sub-supply = <0xffffffff>;
			pinctrl-names = "default", "cam0_rst0", "cam0_rst1", "cam0_pnd0", "cam0_pnd1", "cam1_rst0", "cam1_rst1", "cam1_pnd0", "cam1_pnd1", "cam0_mclk_on", "cam0_mclk_off", "cam1_mclk_on", "cam1_mclk_off";
			pinctrl-0 = <0x23>;
			pinctrl-1 = <0x24>;
			pinctrl-2 = <0x25>;
			pinctrl-3 = <0x26>;
			pinctrl-4 = <0x27>;
			pinctrl-5 = <0x28>;
			pinctrl-6 = <0x29>;
			pinctrl-7 = <0x2a>;
			pinctrl-8 = <0x2b>;
			pinctrl-9 = <0x2c>;
			pinctrl-10 = <0x2d>;
			pinctrl-11 = <0x2e>;
			pinctrl-12 = <0x2f>;
			status = "okay";
		};
	};

	fragment@23 {
		target = <0xffffffff>;

		__overlay__ {
			status = "okay";
		};
	};

	fragment@24 {
		target = <0xffffffff>;

		__overlay__ {
			status = "okay";
			pinctrl-names = "default", "state_uhs";
			pinctrl-0 = <0x30>;
			pinctrl-1 = <0x31>;
			bus-width = <0x08>;
			max-frequency = <0xbebc200>;
			cap-mmc-highspeed;
			mmc-hs200-1_8v;
			mmc-hs400-1_8v;
			supports-cqe;
			hs400-ds-delay = <0x12012>;
			vmmc-supply = <0x32>;
			vqmmc-supply = <0x33>;
			assigned-clocks = <0xffffffff 0x4a>;
			assigned-clock-parents = <0xffffffff 0x36>;
			non-removable;
			no-sd;
			no-sdio;
		};
	};

	fragment@25 {
		target = <0xffffffff>;

		__overlay__ {
			status = "okay";
			pinctrl-names = "default", "state_uhs";
			pinctrl-0 = <0x34>;
			pinctrl-1 = <0x35>;
			bus-width = <0x04>;
			max-frequency = <0xbebc200>;
			cap-sd-highspeed;
			sd-uhs-sdr50;
			sd-uhs-sdr104;
			cd-gpios = <0xffffffff 0x07 0x01>;
			vmmc-supply = <0xffffffff>;
			vqmmc-supply = <0xffffffff>;
			no-mmc;
			no-sdio;
		};
	};

	fragment@26 {
		target = <0xffffffff>;

		__overlay__ {
			charger = <0xffffffff>;
		};
	};

	fragment@27 {
		target = <0xffffffff>;

		__overlay__ {
			bc12_active = <0x01>;
			bootmode = <0xffffffff>;
			charger = <0x36>;
			phys = <0xffffffff 0x03>;
			phy-names = "usb2-phy";
			usb = <0xffffffff>;
			hcn_rsensor = <0x38>;

			port {

				endpoint@0 {
					remote-endpoint = <0x37>;
					phandle = <0x3b>;
				};
			};
		};
	};

	fragment@28 {
		target = <0xffffffff>;

		__overlay__ {
			vcore_sleep-supply = <0xffffffff>;
			vcore_sram_sleep-supply = <0xffffffff>;
		};
	};

	fragment@29 {
		target = <0xffffffff>;

		__overlay__ {
			regulator-max-microvolt = <0x2dc6c0>;
		};
	};

	fragment@30 {
		target = <0xffffffff>;

		__overlay__ {
			regulator-max-microvolt = <0x2dc6c0>;
		};
	};

	fragment@31 {
		target = <0xffffffff>;

		__overlay__ {
			regulator-max-microvolt = <0x2dc6c0>;
		};
	};

	fragment@32 {
		target = <0xffffffff>;

		__overlay__ {
			pinctrl-names = "default";

			accdetdefault {
				phandle = <0x4c>;
			};

			accdeteint@0 {
				phandle = <0x4d>;

				pins_cmd_dat {
					pinmux = <0x900>;
					slew-rate = <0x00>;
					bias-disable;
				};
			};

			alspspincfg {
				phandle = <0x1f>;

				pins_cmd_dat {
					pinmux = <0xa00>;
					slew-rate = <0x00>;
					bias-pull-up = <0x00>;
				};
			};

			alspsdefaultcfg {
				phandle = <0x1e>;
			};

			mosion {
				phandle = <0x04>;

				pins_cmd_dat {
					pinmux = <0x3101 0x3201 0x3301 0x3401>;
					drive-strength = <0x06>;
				};
			};

			mosioff {
				phandle = <0x05>;

				pins_cmd_dat {
					pinmux = <0x3100 0x3200 0x3300 0x3400>;
					input-enable;
					bias-pull-down;
					drive-strength = <0x02>;
				};
			};

			misoon {
				phandle = <0x06>;

				pins_cmd_dat {
					pinmux = <0x3501 0x3601 0x3701 0x3801>;
					drive-strength = <0x06>;
				};
			};

			misooff {
				phandle = <0x07>;

				pins_cmd_dat {
					pinmux = <0x3500 0x3600 0x3700 0x3800>;
					input-enable;
					bias-pull-down;
					drive-strength = <0x02>;
				};
			};

			audiodefault {
				phandle = <0x08>;
			};

			audiodmic {
				phandle = <0x09>;
			};

			audiopcm {
				phandle = <0x0a>;
			};

			audioi2s0 {
				phandle = <0x0b>;
			};

			audioi2s1 {
				phandle = <0x0c>;
			};

			audioi2s2 {
				phandle = <0x0d>;
			};

			audioi2s3 {
				phandle = <0x0e>;
			};

			audiotdmout {
				phandle = <0x0f>;
			};

			audiotdmin {
				phandle = <0x10>;
			};

			camdefault {
				phandle = <0x23>;
			};

			cam0@0 {
				phandle = <0x24>;

				pins_cmd_dat {
					pinmux = <0x200>;
					slew-rate = <0x01>;
					output-low;
				};
			};

			cam0@1 {
				phandle = <0x25>;

				pins_cmd_dat {
					pinmux = <0x200>;
					slew-rate = <0x01>;
					output-high;
				};
			};

			cam0@2 {
				phandle = <0x26>;

				pins_cmd_dat {
					pinmux = <0x300>;
					slew-rate = <0x01>;
					output-low;
				};
			};

			cam0@3 {
				phandle = <0x27>;

				pins_cmd_dat {
					pinmux = <0x300>;
					slew-rate = <0x01>;
					output-high;
				};
			};

			cam1@0 {
				phandle = <0x28>;

				pins_cmd_dat {
					pinmux = <0x00>;
					slew-rate = <0x01>;
					output-low;
				};
			};

			cam1@1 {
				phandle = <0x29>;

				pins_cmd_dat {
					pinmux = <0x00>;
					slew-rate = <0x01>;
					output-high;
				};
			};

			cam1@2 {
				phandle = <0x2a>;

				pins_cmd_dat {
					pinmux = <0x100>;
					slew-rate = <0x01>;
					output-low;
				};
			};

			cam1@3 {
				phandle = <0x2b>;

				pins_cmd_dat {
					pinmux = <0x100>;
					slew-rate = <0x01>;
					output-high;
				};
			};

			camera_pins_cam0_mclk_on {
				phandle = <0x2c>;

				pins_cmd_dat {
					pinmux = <0x4101>;
				};
			};

			camera_pins_cam0_mclk_off {
				phandle = <0x2d>;

				pins_cmd_dat {
					pinmux = <0x4100>;
				};
			};

			camera_pins_cam1_mclk_on {
				phandle = <0x2e>;

				pins_cmd_dat {
					pinmux = <0x4101>;
				};
			};

			camera_pins_cam1_mclk_off {
				phandle = <0x2f>;

				pins_cmd_dat {
					pinmux = <0x4100>;
				};
			};

			consys_default {
				phandle = <0x11>;
			};

			eint0default {
				phandle = <0x3c>;

				pins_cmd_dat {
					pinmux = <0x500>;
					slew-rate = <0x00>;
					bias-disable;
				};
			};

			eint@0 {
				phandle = <0x3d>;

				pins_cmd_dat {
					pinmux = <0x500>;
					slew-rate = <0x00>;
					bias-disable;
				};
			};

			eintoutput0 {
				phandle = <0x3e>;

				pins_cmd_dat {
					pinmux = <0x500>;
					slew-rate = <0x01>;
					output-low;
				};
			};

			eintoutput1 {
				phandle = <0x3f>;

				pins_cmd_dat {
					pinmux = <0x500>;
					slew-rate = <0x01>;
					output-high;
				};
			};

			rstoutput0 {
				phandle = <0x40>;

				pins_cmd_dat {
					pinmux = <0x400>;
					slew-rate = <0x01>;
					output-low;
				};
			};

			rstoutput1 {
				phandle = <0x41>;

				pins_cmd_dat {
					pinmux = <0x400>;
					slew-rate = <0x01>;
					output-high;
				};
			};

			dsp_uartdefault {
				phandle = <0x42>;

				pins_rx {
					pinmux = <0x2507>;
					input-enable;
					bias-pull-up;
				};

				pins_tx {
					pinmux = <0x2607>;
				};
			};

			ethernet {
				phandle = <0x19>;

				pins_ethernet {
					pinmux = <0x04 0x104 0x204 0x304 0x404 0x504 0x604 0x704 0x804 0x904 0xb04 0xc04 0xd04 0xe04 0xf04>;
				};
			};

			gpslna@0 {
				phandle = <0x12>;

				pins_cmd_dat {
					pinmux = <0x4600>;
					slew-rate = <0x00>;
					bias-disable;
					output-low;
				};
			};

			gpslna@1 {
				phandle = <0x13>;

				pins_cmd_dat {
					pinmux = <0x4600>;
					slew-rate = <0x01>;
					output-high;
				};
			};

			gpslna@2 {
				phandle = <0x14>;

				pins_cmd_dat {
					pinmux = <0x4600>;
					slew-rate = <0x01>;
					output-low;
				};
			};

			i2c0 {
				phandle = <0x1a>;

				pins_bus {
					pinmux = <0x3901 0x3a01>;
					bias-pull-up;
				};

				pins_bus1 {
					pinmux = <0x7c00>;
					input-enable;
					bias-pull-up;
				};
			};

			i2c1 {
				phandle = <0x1c>;

				pins_bus {
					pinmux = <0x3b01 0x3c01>;
					bias-pull-up;
				};
			};

			i2c2 {
				phandle = <0x1d>;

				pins_bus {
					pinmux = <0x3d01 0x3e01>;
					bias-pull-up;
				};
			};

			i2c3 {
				phandle = <0x20>;

				pins_bus {
					pinmux = <0x3f01 0x4001>;
					bias-pull-up;
				};
			};

			irrx_pin_ir {
				phandle = <0x21>;

				pins_cmd_dat {
					pinmux = <0xf05>;
					bias-disable;
				};
			};

			kpddefault {
				phandle = <0x22>;

				pins_cols {
					pinmux = <0x1801 0x1901>;
					input-enable;
					bias-pull-up = <0x65>;
				};

				pins_rows {
					pinmux = <0x1601 0x1701>;
					output-low;
					bias-disable;
				};
			};

			mmc0default {
				phandle = <0x30>;

				pins_clk {
					pinmux = <0x6301>;
					bias-pull-down;
				};

				pins_cmd_dat {
					pinmux = <0x6701 0x6601 0x6501 0x6401 0x6001 0x5f01 0x5e01 0x5d01 0x6201>;
					input-enable;
					bias-pull-up;
				};

				pins_rst {
					pinmux = <0x6101>;
					bias-pull-up;
				};
			};

			mmc0 {
				phandle = <0x31>;

				pins_clk {
					pinmux = <0x6301>;
					drive-strength = <0x06>;
					bias-pull-down = <0x65>;
				};

				pins_cmd_dat {
					pinmux = <0x6701 0x6601 0x6501 0x6401 0x6001 0x5f01 0x5e01 0x5d01 0x6201>;
					input-enable;
					drive-strength = <0x06>;
					bias-pull-up = <0x65>;
				};

				pins_ds {
					pinmux = <0x6801>;
					drive-strength = <0x06>;
					bias-pull-down = <0x66>;
				};

				pins_rst {
					pinmux = <0x6101>;
					bias-pull-up;
				};
			};

			mmc1default {
				phandle = <0x34>;

				pins_clk {
					pinmux = <0x5801>;
					drive-strength = <0x04>;
					bias-pull-down = <0x66>;
				};

				pins_cmd_dat {
					pinmux = <0x5901 0x5a01 0x5b01 0x5c01 0x5701>;
					input-enable;
					drive-strength = <0x04>;
					bias-pull-up = <0x65>;
				};

				pins_insert {
					pinmux = <0x700>;
					bias-pull-up;
				};
			};

			mmc1 {
				phandle = <0x35>;

				pins_clk {
					pinmux = <0x5801>;
					drive-strength = <0x06>;
					bias-pull-down = <0x66>;
				};

				pins_cmd_dat {
					pinmux = <0x5901 0x5a01 0x5b01 0x5c01 0x5701>;
					input-enable;
					drive-strength = <0x06>;
					bias-pull-up = <0x65>;
				};
			};

			pwm0default {
				phandle = <0x18>;

				pins_cmd_dat {
					pinmux = <0x1301>;
					output-high;
				};
			};

			panel_pins_default {
				phandle = <0x15>;

				pins_cmd_dat {
					pinmux = <0x1400 0x1500>;
					slew-rate = <0x01>;
					output-high;
				};
			};

			spi@0 {
				phandle = <0x38>;

				pins_spi {
					pinmux = <0x1a01 0x1b01 0x1c01 0x1d01>;
					bias-disable;
				};
			};

			usbid_pins_default {
				phandle = <0x01>;

				pins_cmd_dat {
					pinmux = <0x2700>;
					input-enable;
					slew-rate = <0x00>;
					bias-pull-up;
				};
			};

			wusb_intr {
				phandle = <0x1b>;

				pins_cmd_dat {
					pinmux = <0x5400>;
					slew-rate = <0x00>;
					bias-pull-up = <0x00>;
					output-high;
				};
			};
		};
	};

	fragment@33 {
		target = <0xffffffff>;

		__overlay__ {
			pinctrl-names = "default";
			pinctrl-0 = <0x38>;
			status = "disable";

			spi@0 {
				compatible = "mediatek,spi-mt65xx-test";
				reg = <0x00>;
				spi-max-frequency = <0xf4240>;
				phandle = <0x4e>;
			};
		};
	};

	fragment@34 {
		target = <0xffffffff>;

		__overlay__ {
			phys = <0xffffffff 0x03 0xffffffff 0x03>;
			vusb33-supply = <0xffffffff>;
			vbus-supply = <0x39>;
			dr_mode = "otg";
			usb-role-switch;
			mediatek,u3p-dis-msk = <0x01>;
			cdp-block;
			wakeup-source;
			status = "okay";

			port {

				endpoint@0 {
					remote-endpoint = <0x3a>;
					phandle = <0x03>;
				};

				endpoint@1 {
					remote-endpoint = <0x3b>;
					phandle = <0x37>;
				};
			};
		};
	};

	fragment@35 {
		target = <0xffffffff>;

		__overlay__ {
			vtouch-supply = <0xffffffff>;
			tpd-resolution = <0x1e0 0x320>;
			use-tpd-button = <0x00>;
			tpd-key-num = <0x03>;
			tpd-key-local = <0x8b 0xac 0x9e 0x00>;
			tpd-key-dim-local = <0x5a 0x373 0x64 0x28 0xe6 0x373 0x64 0x28 0x172 0x373 0x64 0x28 0x00 0x00 0x00 0x00>;
			tpd-max-touch-num = <0x05>;
			tpd-filter-enable = <0x01>;
			tpd-filter-pixel-density = <0x7c>;
			tpd-filter-custom-prameters = <0x00 0x00 0x00 0x00 0x00 0x00 0x00 0x00 0x00 0x00 0x00 0x00>;
			tpd-filter-custom-speed = <0x00 0x00 0x00>;
			pinctrl-names = "default", "state_eint_as_int", "state_eint_output0", "state_eint_output1", "state_rst_output0", "state_rst_output1";
			pinctrl-0 = <0x3c>;
			pinctrl-1 = <0x3d>;
			pinctrl-2 = <0x3e>;
			pinctrl-3 = <0x3f>;
			pinctrl-4 = <0x40>;
			pinctrl-5 = <0x41>;
			status = "okay";
		};
	};

	fragment@36 {
		target = <0xffffffff>;

		__overlay__ {
			status = "okay";
		};
	};

	fragment@37 {
		target = <0xffffffff>;

		__overlay__ {
			status = "okay";
		};
	};

	fragment@38 {
		target = <0xffffffff>;

		__overlay__ {
			pinctrl-names = "default";
			pinctrl-0 = <0x42>;
			status = "okay";
		};
	};

	fragment@39 {
		target = <0xffffffff>;

		__overlay__ {
			mediatek,discth = <0x0a>;
		};
	};

	__symbols__ {
		extcon_usb = "/fragment@2/__overlay__/extcon_iddig";
		usb_role = "/fragment@2/__overlay__/extcon_iddig/port/endpoint@0";
		mt_soc_codec_name = "/fragment@2/__overlay__/mt_soc_codec_name";
		mmc_fixed_3v3 = "/fragment@2/__overlay__/fixedregulator0";
		mmc_fixed_1v8_io = "/fragment@2/__overlay__/fixedregulator1";
		sound = "/fragment@2/__overlay__/sound";
		pwmleds = "/fragment@2/__overlay__/pwmleds";
		usb_p0_vbus = "/fragment@2/__overlay__/regulator@0";
		wusb3801x = "/fragment@2/__overlay__/type_c_port0";
		panel0_in = "/fragment@13/__overlay__/panel0@0/port/endpoint";
		panel1_in = "/fragment@13/__overlay__/panel1@1/port/endpoint";
		panel2_in = "/fragment@13/__overlay__/panel2@2/port/endpoint";
		dsi_out = "/fragment@13/__overlay__/ports/port/endpoint";
		usb_typec_will = "/fragment@16/__overlay__/wusb3801@60";
		fsa4480_12c = "/fragment@16/__overlay__/fsa4480-12c@42";
		eta6937_chg = "/fragment@16/__overlay__/eta6937@6a";
		eta6937_otg_vbus = "/fragment@16/__overlay__/eta6937@6a/usb-otg-vbus";
		usb_role1 = "/fragment@27/__overlay__/port/endpoint@0";
		accdet_pins_default = "/fragment@32/__overlay__/accdetdefault";
		accdet_pins_eint_as_int = "/fragment@32/__overlay__/accdeteint@0";
		alsps_intpin_cfg = "/fragment@32/__overlay__/alspspincfg";
		alsps_intpin_default = "/fragment@32/__overlay__/alspsdefaultcfg";
		aud_pins_mosi_on = "/fragment@32/__overlay__/mosion";
		aud_pins_mosi_off = "/fragment@32/__overlay__/mosioff";
		aud_pins_miso_on = "/fragment@32/__overlay__/misoon";
		aud_pins_miso_off = "/fragment@32/__overlay__/misooff";
		aud_pins_default = "/fragment@32/__overlay__/audiodefault";
		aud_pins_dmic = "/fragment@32/__overlay__/audiodmic";
		aud_pins_pcm = "/fragment@32/__overlay__/audiopcm";
		aud_pins_i2s0 = "/fragment@32/__overlay__/audioi2s0";
		aud_pins_i2s1 = "/fragment@32/__overlay__/audioi2s1";
		aud_pins_i2s2 = "/fragment@32/__overlay__/audioi2s2";
		aud_pins_i2s3 = "/fragment@32/__overlay__/audioi2s3";
		aud_pins_tdm_out = "/fragment@32/__overlay__/audiotdmout";
		aud_pins_tdm_in = "/fragment@32/__overlay__/audiotdmin";
		camera_pins_default = "/fragment@32/__overlay__/camdefault";
		camera_pins_cam0_rst0 = "/fragment@32/__overlay__/cam0@0";
		camera_pins_cam0_rst1 = "/fragment@32/__overlay__/cam0@1";
		camera_pins_cam0_pnd0 = "/fragment@32/__overlay__/cam0@2";
		camera_pins_cam0_pnd1 = "/fragment@32/__overlay__/cam0@3";
		camera_pins_cam1_rst0 = "/fragment@32/__overlay__/cam1@0";
		camera_pins_cam1_rst1 = "/fragment@32/__overlay__/cam1@1";
		camera_pins_cam1_pnd0 = "/fragment@32/__overlay__/cam1@2";
		camera_pins_cam1_pnd1 = "/fragment@32/__overlay__/cam1@3";
		camera_pins_cam0_mclk_on = "/fragment@32/__overlay__/camera_pins_cam0_mclk_on";
		camera_pins_cam0_mclk_off = "/fragment@32/__overlay__/camera_pins_cam0_mclk_off";
		camera_pins_cam1_mclk_on = "/fragment@32/__overlay__/camera_pins_cam1_mclk_on";
		camera_pins_cam1_mclk_off = "/fragment@32/__overlay__/camera_pins_cam1_mclk_off";
		consys_pins_default = "/fragment@32/__overlay__/consys_default";
		CTP_pins_default = "/fragment@32/__overlay__/eint0default";
		CTP_pins_eint_as_int = "/fragment@32/__overlay__/eint@0";
		CTP_pins_eint_output0 = "/fragment@32/__overlay__/eintoutput0";
		CTP_pins_eint_output1 = "/fragment@32/__overlay__/eintoutput1";
		CTP_pins_rst_output0 = "/fragment@32/__overlay__/rstoutput0";
		CTP_pins_rst_output1 = "/fragment@32/__overlay__/rstoutput1";
		dsp_uart_pin = "/fragment@32/__overlay__/dsp_uartdefault";
		ethernet_pins_default = "/fragment@32/__overlay__/ethernet";
		gpslna_pins_init = "/fragment@32/__overlay__/gpslna@0";
		gpslna_pins_oh = "/fragment@32/__overlay__/gpslna@1";
		gpslna_pins_ol = "/fragment@32/__overlay__/gpslna@2";
		i2c0_pins = "/fragment@32/__overlay__/i2c0";
		i2c1_pins = "/fragment@32/__overlay__/i2c1";
		i2c2_pins = "/fragment@32/__overlay__/i2c2";
		i2c3_pins = "/fragment@32/__overlay__/i2c3";
		irrx_pins_ir_input = "/fragment@32/__overlay__/irrx_pin_ir";
		kpd_pins_default = "/fragment@32/__overlay__/kpddefault";
		mmc0_pins_default = "/fragment@32/__overlay__/mmc0default";
		mmc0_pins_uhs = "/fragment@32/__overlay__/mmc0";
		mmc1_pins_default = "/fragment@32/__overlay__/mmc1default";
		mmc1_pins_uhs = "/fragment@32/__overlay__/mmc1";
		pwm0_gpio_def_cfg = "/fragment@32/__overlay__/pwm0default";
		panel_pins_default = "/fragment@32/__overlay__/panel_pins_default";
		spi_pins = "/fragment@32/__overlay__/spi@0";
		usbid_pins_default = "/fragment@32/__overlay__/usbid_pins_default";
		wusb_intr = "/fragment@32/__overlay__/wusb_intr";
		spidev0 = "/fragment@33/__overlay__/spi@0";
		mtu3_drd_switch = "/fragment@34/__overlay__/port/endpoint@0";
		mtu3_drd_switch1 = "/fragment@34/__overlay__/port/endpoint@1";
	};

	__fixups__ {
		charger = "/fragment@0:target:0", "/fragment@7:target:0";
		mtk_gauge = "/fragment@1:target:0", "/fragment@7/__overlay__:gauge:0", "/fragment@26:target:0";
		odm = "/fragment@2:target:0";
		pio = "/fragment@2/__overlay__/extcon_iddig:id-gpio:0", "/fragment@2/__overlay__/sound:ext-amp1-gpio:0", "/fragment@2/__overlay__/sound:ext-amp2-gpio:0", "/fragment@2/__overlay__/regulator@0:gpio:0", "/fragment@2/__overlay__/type_c_port0:mt6370pd,intr_gpio:0", "/fragment@13/__overlay__/panel0@0:pwr-gpios:0", "/fragment@13/__overlay__/panel0@0:rst-gpios:0", "/fragment@13/__overlay__/panel1@1:pwr-gpios:0", "/fragment@13/__overlay__/panel1@1:rst-gpios:0", "/fragment@13/__overlay__/panel2@2:pwr-gpios:0", "/fragment@13/__overlay__/panel2@2:rst-gpios:0", "/fragment@16/__overlay__/eta6937@6a:interrupt-parent:0", "/fragment@16/__overlay__/eta6937@6a:hl7005,cd_pin:0", "/fragment@17/__overlay__/cap_touch@5d:interrupt-parent:0", "/fragment@17/__overlay__/cap_touch@5d:int-gpio:0", "/fragment@17/__overlay__/cap_touch@5d:rst-gpio:0", "/fragment@18/__overlay__/alsps@23:interrupt-parent:0", "/fragment@25/__overlay__:cd-gpios:0", "/fragment@32:target:0";
		mtk_charger_type = "/fragment@2/__overlay__/extcon_iddig:charger:0", "/fragment@7/__overlay__:charger:0", "/fragment@26/__overlay__:charger:0", "/fragment@27:target:0";
		afe = "/fragment@2/__overlay__/sound:mediatek,platform:0", "/fragment@4:target:0";
		adsp_pcm = "/fragment@2/__overlay__/sound:mediatek,adsp-platform:0", "/fragment@5:target:0";
		accdet = "/fragment@2/__overlay__/sound:mediatek,headset-codec:0", "/fragment@3:target:0";
		disp_pwm0 = "/fragment@2/__overlay__/pwmleds/backlight:pwms:0", "/fragment@14:target:0";
		auxadc = "/fragment@6:target:0";
		chosen = "/fragment@7/__overlay__:bootmode:0", "/fragment@27/__overlay__:bootmode:0";
		consys = "/fragment@8:target:0";
		cpu0 = "/fragment@9:target:0";
		cpu1 = "/fragment@10:target:0";
		cpu2 = "/fragment@11:target:0";
		cpu3 = "/fragment@12:target:0";
		dsi0 = "/fragment@13:target:0";
		mt_pmic_vibr_ldo_reg = "/fragment@13/__overlay__/panel0@0:lcmavdd-supply:0", "/fragment@13/__overlay__/panel1@1:lcmavdd-supply:0", "/fragment@13/__overlay__/panel2@2:lcmavdd-supply:0";
		ethernet = "/fragment@15:target:0";
		i2c0 = "/fragment@16:target:0";
		i2c1 = "/fragment@17:target:0";
		i2c2 = "/fragment@18:target:0";
		i2c3 = "/fragment@19:target:0";
		irrx = "/fragment@20:target:0";
		keypad = "/fragment@21:target:0";
		kd_camera_hw1 = "/fragment@22:target:0";
		mt_pmic_vcama_ldo_reg = "/fragment@22/__overlay__:vcama-supply:0", "/fragment@22/__overlay__:vcama_sub-supply:0";
		mt_pmic_vcamd_ldo_reg = "/fragment@22/__overlay__:vcamd-supply:0", "/fragment@22/__overlay__:vcamd_sub-supply:0";
		mt_pmic_vcamio_ldo_reg = "/fragment@22/__overlay__:vcamio-supply:0", "/fragment@22/__overlay__:vcamio_sub-supply:0";
		mipi_tx0 = "/fragment@23:target:0";
		mmc0 = "/fragment@24:target:0";
		topckgen = "/fragment@24/__overlay__:assigned-clocks:0", "/fragment@24/__overlay__:assigned-clock-parents:0";
		mmc1 = "/fragment@25:target:0";
		mt_pmic_vmch_ldo_reg = "/fragment@25/__overlay__:vmmc-supply:0", "/fragment@31:target:0";
		mt_pmic_vmc_ldo_reg = "/fragment@25/__overlay__:vqmmc-supply:0", "/fragment@30:target:0";
		u2port0 = "/fragment@27/__overlay__:phys:0", "/fragment@34/__overlay__:phys:0", "/fragment@39:target:0";
		ssusb = "/fragment@27/__overlay__:usb:0", "/fragment@34:target:0";
		mtk_sloa = "/fragment@28:target:0";
		mt_pmic_vcore_sleep_ldo_reg = "/fragment@28/__overlay__:vcore_sleep-supply:0";
		mt_pmic_vsram_proc_sleep_ldo_reg = "/fragment@28/__overlay__:vcore_sram_sleep-supply:0";
		mt_pmic_vemc_ldo_reg = "/fragment@29:target:0";
		spi = "/fragment@33:target:0";
		u2port1 = "/fragment@34/__overlay__:phys:8";
		mt_pmic_vusb33_ldo_reg = "/fragment@34/__overlay__:vusb33-supply:0";
		touch = "/fragment@35:target:0";
		mt_pmic_vldo28_ldo_reg = "/fragment@35/__overlay__:vtouch-supply:0";
		u3phy0 = "/fragment@36:target:0";
		uart0 = "/fragment@37:target:0";
		uart1 = "/fragment@38:target:0";
	};

	__local_fixups__ {

		fragment@2 {

			__overlay__ {

				extcon_iddig {
					pinctrl-0 = <0x00>;
					vbus-supply = <0x00>;

					port {

						endpoint@0 {
							remote-endpoint = <0x00>;
						};
					};
				};

				sound {
					pinctrl-0 = <0x00>;
					pinctrl-1 = <0x00>;
					pinctrl-2 = <0x00>;
					pinctrl-3 = <0x00>;
					pinctrl-4 = <0x00>;
					pinctrl-5 = <0x00>;
					pinctrl-6 = <0x00>;
					pinctrl-7 = <0x00>;
					pinctrl-8 = <0x00>;
					pinctrl-9 = <0x00>;
					pinctrl-10 = <0x00>;
					pinctrl-11 = <0x00>;
					pinctrl-12 = <0x00>;
				};
			};
		};

		fragment@8 {

			__overlay__ {
				pinctrl-0 = <0x00>;
				pinctrl-1 = <0x00>;
				pinctrl-2 = <0x00>;
				pinctrl-3 = <0x00>;
			};
		};

		fragment@13 {

			__overlay__ {

				panel0@0 {
					pinctrl-0 = <0x00>;

					port {

						endpoint {
							remote-endpoint = <0x00>;
						};
					};
				};

				panel1@1 {
					pinctrl-0 = <0x00>;

					port {

						endpoint {
							remote-endpoint = <0x00>;
						};
					};
				};

				panel2@2 {
					pinctrl-0 = <0x00>;

					port {

						endpoint {
							remote-endpoint = <0x00>;
						};
					};
				};

				ports {

					port {

						endpoint {
							remote-endpoint = <0x00>;
						};
					};
				};
			};
		};

		fragment@14 {

			__overlay__ {
				pinctrl-0 = <0x00>;
			};
		};

		fragment@15 {

			__overlay__ {
				pinctrl-0 = <0x00>;
			};
		};

		fragment@16 {

			__overlay__ {
				pinctrl-0 = <0x00>;

				wusb3801@60 {
					pinctrl-0 = <0x00>;
				};
			};
		};

		fragment@17 {

			__overlay__ {
				pinctrl-0 = <0x00>;
			};
		};

		fragment@18 {

			__overlay__ {
				pinctrl-0 = <0x00>;

				alsps@23 {
					pinctrl-0 = <0x00>;
					pinctrl-1 = <0x00>;
				};
			};
		};

		fragment@19 {

			__overlay__ {
				pinctrl-0 = <0x00>;
			};
		};

		fragment@20 {

			__overlay__ {
				pinctrl-0 = <0x00>;
			};
		};

		fragment@21 {

			__overlay__ {
				pinctrl-0 = <0x00>;
			};
		};

		fragment@22 {

			__overlay__ {
				pinctrl-0 = <0x00>;
				pinctrl-1 = <0x00>;
				pinctrl-2 = <0x00>;
				pinctrl-3 = <0x00>;
				pinctrl-4 = <0x00>;
				pinctrl-5 = <0x00>;
				pinctrl-6 = <0x00>;
				pinctrl-7 = <0x00>;
				pinctrl-8 = <0x00>;
				pinctrl-9 = <0x00>;
				pinctrl-10 = <0x00>;
				pinctrl-11 = <0x00>;
				pinctrl-12 = <0x00>;
			};
		};

		fragment@24 {

			__overlay__ {
				pinctrl-0 = <0x00>;
				pinctrl-1 = <0x00>;
				vmmc-supply = <0x00>;
				vqmmc-supply = <0x00>;
			};
		};

		fragment@25 {

			__overlay__ {
				pinctrl-0 = <0x00>;
				pinctrl-1 = <0x00>;
			};
		};

		fragment@27 {

			__overlay__ {
				charger = <0x00>;

				port {

					endpoint@0 {
						remote-endpoint = <0x00>;
					};
				};
			};
		};

		fragment@33 {

			__overlay__ {
				pinctrl-0 = <0x00>;
			};
		};

		fragment@34 {

			__overlay__ {
				vbus-supply = <0x00>;

				port {

					endpoint@0 {
						remote-endpoint = <0x00>;
					};

					endpoint@1 {
						remote-endpoint = <0x00>;
					};
				};
			};
		};

		fragment@35 {

			__overlay__ {
				pinctrl-0 = <0x00>;
				pinctrl-1 = <0x00>;
				pinctrl-2 = <0x00>;
				pinctrl-3 = <0x00>;
				pinctrl-4 = <0x00>;
				pinctrl-5 = <0x00>;
			};
		};

		fragment@38 {

			__overlay__ {
				pinctrl-0 = <0x00>;
			};
		};
	};
};
